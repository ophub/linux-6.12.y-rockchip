// SPDX-License-Identifier: (GPL-2.0+ OR MIT)
/*
 * Guangzhou Easy EAI Technology Co., Ltd.
 *
 */

&i2c2 {
	pinctrl-names = "default";
	pinctrl-0 = <&i2c2m0_xfer>;
	status = "okay";
};

&i2c8 {
	pinctrl-names = "default";
	pinctrl-0 = <&i2c8m1_xfer>;
	status = "okay";
};
