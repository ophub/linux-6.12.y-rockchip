// SPDX-License-Identifier: (GPL-2.0+ OR MIT)
/*
 * Guangzhou Easy EAI Technology Co., Ltd.
 *
 */

&uart4 {
	pinctrl-names = "default";
	pinctrl-0 = <&uart4m2_xfer>;
	status = "okay";
};

&uart8 {
	pinctrl-names = "default";
	pinctrl-0 = <&uart8m1_xfer>;
	status = "okay";
};


&uart10 {
	pinctrl-names = "default";
	pinctrl-0 = <&uart10m1_xfer>;
	status = "okay";
};
